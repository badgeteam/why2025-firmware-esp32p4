## components/badge-bsp/Kconfig
```kconfig
menu "Badge.team BSP"
    choice
        prompt "Badge platform"
        default BSP_PLATFORM_WHY2025
        
        config BSP_PLATFORM_WHY2025
            select BSP_SUPPORT_ST7701
            select BSP_SUPPORT_WHY2025_COPROC
            bool "WHY2025 badge prototype 2"
        
        config BSP_PLATFORM_P4DEVKIT01
            select BSP_SUPPORT_EK79007
            bool "ESP32-P4 devkit v0.1 (default screen)"
        
        config BSP_PLATFORM_P4DEVKIT01_ST7701
            select BSP_SUPPORT_ST7701
            bool "ESP32-P4 devkit v0.1 (WHY2025's ST7701)"
    endchoice
    
    config BSP_PAX_INTEGRATION
        default y
        bool "Enable the BSP's PAX graphics helper functions"
    
    config BSP_SUPPORT_MIPI_DSI
        bool "Support MIPI DSI displays"
    
    config BSP_SUPPORT_ST7701
        select BSP_SUPPORT_MIPI_DSI
        bool "Support the ST7701 display driver"
    
    config BSP_SUPPORT_EK79007
        select BSP_SUPPORT_MIPI_DSI
        bool "Support the EK79007 display driver"
    
    config BSP_SUPPORT_WHY2025_COPROC
        bool "Support the WHY2025 badge's co-processors"
endmenu
```

## components/esptoolsquared/Kconfig
```kconfig
menu "esptoolsquared"
    config ET2_SUPPORT_ESP32C2
        bool "Enable support stub for ESP32-C2"
        default n
    config ET2_SUPPORT_ESP32C3
        bool "Enable support stub for ESP32-C3"
        default n
    config ET2_SUPPORT_ESP32C6
        bool "Enable support stub for ESP32-C6"
        default y
    config ET2_SUPPORT_ESP32P4
        bool "Enable support stub for ESP32-P4"
        default n
    config ET2_SUPPORT_ESP32S2
        bool "Enable support stub for ESP32-S2"
        default n
    config ET2_SUPPORT_ESP32S3
        bool "Enable support stub for ESP32-S3"
        default n
endmenu
```

## sdkconfig.defaults
```kconfig
CONFIG_BOOTLOADER_CUSTOM_RESERVE_RTC=y
CONFIG_BOOTLOADER_CUSTOM_RESERVE_RTC_SIZE=0x100

CONFIG_ESPTOOLPY_FLASHSIZE_16MB=y

CONFIG_PARTITION_TABLE_CUSTOM=y
CONFIG_PARTITION_TABLE_CUSTOM_FILENAME="partitions.csv"
CONFIG_PARTITION_TABLE_FILENAME="partitions.csv"
CONFIG_PARTITION_TABLE_OFFSET=0xB000
CONFIG_PARTITION_TABLE_MD5=y

CONFIG_SPI_FLASH_DANGEROUS_WRITE_ALLOWED=y

CONFIG_SPIRAM=y

CONFIG_SPIRAM_MODE_HEX=y
CONFIG_SPIRAM_SPEED_200M=y
CONFIG_SPIRAM_SPEED=200
CONFIG_SPIRAM_ALLOW_STACK_EXTERNAL_MEMORY=y
CONFIG_SPIRAM_BOOT_INIT=y
CONFIG_SPIRAM_USE_MALLOC=y
CONFIG_SPIRAM_MEMTEST=y
CONFIG_SPIRAM_MALLOC_ALWAYSINTERNAL=16384
CONFIG_SPIRAM_MALLOC_RESERVE_INTERNAL=32768
CONFIG_SPIRAM_ALLOW_BSS_SEG_EXTERNAL_MEMORY=y

CONFIG_IDF_EXPERIMENTAL_FEATURES=y
```
